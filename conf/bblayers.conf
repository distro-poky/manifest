## conf/bblayers.conf
```bitbake
# conf/bblayers.conf

LCONF_VERSION = "7"

BBPATH = "${TOPDIR}"
BSPDIR := "${@os.path.abspath(os.path.dirname(d.getVar('FILE', True)) + '/../..')}"

BBFILES ?= ""

# FOSS Layers
BBLAYERS_SW_FOSS = " \
    ${BSPDIR}/layers/meta-clang \
    ${BSPDIR}/layers/meta-distro-poky \
    ${BSPDIR}/layers/meta-qt5 \
    ${BSPDIR}/layers/meta-security \
    ${BSPDIR}/layers/meta-selinux \
    ${BSPDIR}/layers/meta-updater \
    ${BSPDIR}/layers/meta-virtualization \
"

# Closed Layers
BBLAYERS_SW_CLOSED = " \
"

# Poky and Openembedded Layers
BBLAYERS_SW_POKY = " \
    ${BSPDIR}/layers/poky/meta \
    ${BSPDIR}/layers/poky/meta-poky \
    ${BSPDIR}/layers/meta-openembedded/meta-oe \
    ${BSPDIR}/layers/meta-openembedded/meta-multimedia \
    ${BSPDIR}/layers/meta-openembedded/meta-perl \
    ${BSPDIR}/layers/meta-openembedded/meta-python \
    ${BSPDIR}/layers/meta-openembedded/meta-filesystems \
    ${BSPDIR}/layers/meta-openembedded/meta-gnome \
    ${BSPDIR}/layers/meta-openembedded/meta-networking \
"

# Intel BSP Layers
BBLAYERS_HW_INTEL = " \
    ${BSPDIR}/layers/meta-intel \
    ${BSPDIR}/layers/meta-secure-core/meta \
    ${BSPDIR}/layers/meta-secure-core/meta-signing-key \
    ${BSPDIR}/layers/meta-secure-core/meta-tpm \
    ${BSPDIR}/layers/meta-secure-core/meta-tpm2 \
    ${BSPDIR}/layers/meta-secure-core/meta-efi-secure-boot \
    ${BSPDIR}/layers/meta-secure-core/meta-integrity \
    ${BSPDIR}/layers/meta-secure-core/meta-encrypted-storage \
"

# Varascite BSP Layers
BBLAYERS_HW_VARASCITE = " \
    ${BSPDIR}/layers/meta-freescale \
    ${BSPDIR}/layers/meta-freescale-3rdparty \
    ${BSPDIR}/layers/meta-freescale-distro \
    ${BSPDIR}/layers/meta-variscite-fslc \
"

BBLAYERS = " \
    ${BBLAYERS_SW_FOSS} \
    ${BBLAYERS_SW_CLOSED} \
    ${BBLAYERS_SW_POKY} \
    ${BBLAYERS_HW_INTEL} \
    ${BBLAYERS_HW_VARASCITE} \
"
```

## conf/local.conf
```bitbake
# conf/local.conf

CONF_VERSION = "1"

DISTRO ?= 'foss-base'
MACHINE ??= 'qemux86-64'
SDKMACHINE ?= "x86_64"
PACKAGE_CLASSES ?= 'package_rpm'

PARALLEL_MAKE ?= "-j ${@oe.utils.cpu_count()}"
BB_NUMBER_THREADS ?= "${@oe.utils.cpu_count()}"

USER_CLASSES ?= "buildstats image-mklibs image-prelink"
PATCHRESOLVE = "noop"
EXTRA_IMAGE_FEATURES ?= "package-management"

DL_DIR ?= "${BSPDIR}/downloads"
SSTATE_DIR ?= "${BSPDIR}/sstate-cache"
TMPDIR ?= "${TOPDIR}/tmp"

BB_DISKMON_DIRS ??= "\
    STOPTASKS,${TMPDIR},1G,100K \
    STOPTASKS,${DL_DIR},1G,100K \
    STOPTASKS,${SSTATE_DIR},1G,100K \
    STOPTASKS,/tmp,100M,100K \
    ABORT,${TMPDIR},100M,1K \
    ABORT,${DL_DIR},100M,1K \
    ABORT,${SSTATE_DIR},100M,1K \
    ABORT,/tmp,10M,1K"

# Build History
INHERIT_append = " buildhistory"
BUILDHISTORY_COMMIT = "0"
BUILDHISTORY_FEATURES = "image"

# Remove Work
INHERIT_append = " rm_work"

# Clang Tool Chain
TOOLCHAIN ?= "clang"
#INHERIT_append = " scan-build"
#TOOLCHAIN_TARGET_TASK_append = " libc-staticdev"

# QEMU Configuration
PACKAGECONFIG_append_pn-qemu-system-native = " sdl"

# FSL EULA Acceptance
ACCEPT_FSL_EULA = "1"
```
